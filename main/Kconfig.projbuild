## main/Kconfig.projbuild
```kconfig
# @file Kconfig.projbuild
# @brief ESP menuconfig options
# @author Milan Vodák <xvodak07@stud.fit.vut.cz>

menu "Metronome"

    config WIFI_SSID
        string "WiFi SSID"
        default "myssid"
        help
            SSID (network name) for the metronome to connect to.

    config WIFI_PASSWORD
        string "WiFi Password"
        default "mypassword"
        help
            WiFi password (WPA or WPA2) for the metronome to use.

    config GPIO_PIN
        int "GPIO output pin"
        range 0 33
        default 12
        help
            Pin number to use for enabling the metronome.

    config PWM_PIN
        int "PWM output pin"
        default 13
        help
            Pin number to use for regulating metronome volume.

endmenu
```
